#include <drako/tests.h>
#include <pico/rand.h>
#include <stdio.h>
#include <stdlib.h>


void full_test(at28c64b* prom, display* disp) {
    // generate random starting address that's no greater than 0x0FFF
    uint32_t addr = get_rand_32() % 0x0FFF;

    // create array of to-be-generated bytes
    size_t n = 10;
    uint8_t bytes[n];

    // write `n` random values to at28c64b sequentially.
    at28c64b_select(prom);
    printf("        ADDR       BYTE\n");
    uint8_t i;
    for(i = 0; i < n; i++) {
        // generate random byte and save for later validation
        bytes[i] = get_rand_32() % 0xFF;
        // write byte to address (contiguously incremented)
        at28c64b_write8(prom, addr + i, bytes[i]);
        // print update to serial
        printf("WRITE: 0x%.4x <--- 0x%.2x\n", addr+i, bytes[i]);
    }

    // read `n` values that were written to EEPROM starting at `addr`
    uint8_t byte;
    for(i = 0; i < n; i++) {
        at28c64b_select(prom);
        at28c64b_read8(prom, addr+i, &byte);
        if (byte == bytes[i])
            printf("READ : 0x%.4x ---> 0x%.2x     [CORRECT]\n", addr+i, byte);
        else
            printf("READ : 0x%.4x ---> 0x%.2x     [-ERROR-]\n", addr+i, byte);

        // display byte
        display_select(disp);
        display_hex(disp, byte);

        // sleep for 1s
        sleep_ms(1000);
    }
}


size_t randomized_full_test(at28c64b* prom, display* disp, size_t nbytes) {
    // loop control vars
    bool duplicateFound = false;
    size_t i = 0;
    size_t j = 0;

    // arrays to store rng addrs and bytes for checking
    uint16_t addrs[nbytes];
    uint8_t  bytes[nbytes];

    // clear display
    display_select(disp);
    display_clear(disp);
    display_hide(disp);

    // make sure to enable at28c64b databus and chipselect
    at28c64b_select(prom);

    printf("Running Test: Randomized Full Test\n");
    printf("    Writing random bytes to random addresses... \n");

#ifdef RNG_FULL_TEST_DEBUG
    printf("[WRITE TEST] Randomly generating addresses and bytes: \n");
    printf("[WRITE TEST]     ADDR      BYTE\n");
#endif

    // populate arrays and write rng bytes to their rng address
    for (i = 0; i < nbytes; i++) {
        // generate RNG addr and byte
        bytes[i] = (uint8_t )(get_rand_32() % UINT8_MAX);
        addrs[i] = (uint16_t)(get_rand_32() % 0x07FF);

        // make sure addr isnt already being tested
        while (true) {
            duplicateFound = false;
            for (j = 0; j < i; j++) {
                // if duplicate found, generate new rng addr and check again
                if (addrs[i] == addrs[j]) {
                    addrs[i] = (uint16_t)(get_rand_32() % 0x07FF);
                    duplicateFound = true;
                    break;
                }
            }

            // if no duplicate found, break loop
            if (!duplicateFound)
                break;
        }

        at28c64b_write8(prom, addrs[i], bytes[i]);

#ifndef RNG_FULL_TEST_DEBUG
        printf("        %d/%d writes completed\r", i+1, nbytes);
#endif

#ifdef RNG_FULL_TEST_DEBUG
        printf("[WRITE TEST]    0x%04x    0x%02x\n", addrs[i], bytes[i]);
#endif
    }

#ifndef RNG_FULL_TEST_DEBUG
    printf("\n");
#endif

    printf("    Validating writes...\n");
#ifdef RNG_FULL_TEST_DEBUG
    printf("[READ TEST] Checking written values:\n");
    printf("[READ TEST]      ADDR     BYTE    STATUS\n");
#endif

    // check written bytes
    uint8_t byte;
    size_t failCount = 0;
    for (i = 0; i < nbytes; i++) {
        // read byte from at28c64b
        at28c64b_read8(prom, addrs[i], &byte);

#ifdef RNG_FULL_TEST_DEBUG
        printf("[READ TEST]     0x%04x    0x%02x    ", addrs[i], byte);

        // check if read byte matches what was supposed to be written
        if (byte != bytes[i]) {
            failCount++;
            printf("FAIL    expected 0x%02x\n", bytes[i]);
        } else {
            printf("PASS\n");
        }
#endif
#ifndef RNG_FULL_TEST_DEBUG
        printf("        %d/%d checks completed\r", i+1, nbytes);
#endif
    }
#ifndef RNG_FULL_TEST_DEBUG
    printf("\n");
#endif

    printf(
            "Randomized Full Test Completed.\n"
            "    Tests Run: %10d\n"
            "    Failures : %10d (%.02f%%)\n"
            "    Grade    : %10s\n",
            nbytes,
            failCount,
            (float)(failCount)/nbytes,
            failCount > 0 ? "FAIL" : "PASS"
    );
    fflush(stdout);
    return failCount;
}

